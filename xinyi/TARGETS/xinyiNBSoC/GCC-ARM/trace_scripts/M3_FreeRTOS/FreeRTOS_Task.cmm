; do Display Task
GOSUB display_task
ENDDO


display_task:
(
	PRIVATE &NumOfThread &TaskHandlerList
	GOSUB get_task_handler_list
	ENTRY &NumOfThread &TaskHandlerList

	&TaskNameLen=0xC
	&PriorityLen=0x6
	&TaskStateLen=0xC
	&StackTypeLen=0xC
	&TaskCtlBlockLen=0xC
	&CurrentSPLen=0xC
	&StackTopLen=0xC
	&StackBottomLen=0xC
	&StackSizeLen=0x7
	&StackPercentLen=0x5
	&BoxWidth=&NumOfThread+2
	&MemberGap=0x1
	&DialogFileName="task_dialog.dlg"
	
	PRIVATE &DrawLine
	
	&DrawLine=0x0
	
	OPEN #1 &DialogFileName /Create
	CLOSE #1
	
	GOSUB dialog_show_task_title &DrawLine
	
	IF &NumOfThread!=0
	(
		PRIVATE &pxCurrentTCB
		PRIVATE &StartLen &StartLenDec &NextHandler &NextHandlerDec &StopLen &HandlerLen &HandlerLenDec
		
		&StartLen=STRing.SCAN("&TaskHandlerList","0x",0.)
	
		RePeaT &NumOfThread
		(
			&StartLenDec=CONVert.HEXTOINT(&StartLen)
			
			&NextHandler=&StartLen+2
			&NextHandlerDec=CONVert.HEXTOINT(&NextHandler)
			&StopLen=STRing.SCAN("&TaskHandlerList","0x",&NextHandlerDec)
			
			IF &StopLen!=-1
			(
				&HandlerLen=&StopLen-&StartLen
				&StartLen=&StopLen
			)
			ELSE
			(
				PRIVATE &HandlerListLen
				&HandlerListLen=STRing.LENgth("&TaskHandlerList")
				&HandlerLen=&HandlerListLen-&StartLen
			)
			
			&HandlerLenDec=CONVert.HEXTOINT(&HandlerLen)
			&pxCurrentTCB=STRing.MID("&TaskHandlerList",&StartLenDec,&HandlerLenDec)
			&DrawLine=&DrawLine+0x1
			GOSUB dialog_show_task_one_line &pxCurrentTCB &DrawLine
		)
	)
	
	&DrawLine=&DrawLine+0x1
	GOSUB dialog_show_task_others &DrawLine
	
	;DIALOG.END
	
	;WinPOS ,,,,,, task_window
	;AREA.Delete task_window
	;AREA.Create task_window ;create a named area that is invisible
	;AREA.Select task_window ;select this area for output
	;DIALOG.AREA task_window &DialogFileName
	DIALOG.View &DialogFileName
	RM &DialogFileName
	
	RETURN
)


dialog_show_task_title:
(
	ENTRY &AcceptParameter
	
	PRIVATE &DrawLineNum
	&DrawLineNum=FORMAT.Decimal(2,&AcceptParameter)
	
	PRIVATE &CurrentSize &CurrentBoxPosition &CurrentBoxLen &BoxWidthNum
	
	&CurrentSize=0
	&BoxWidthNum=FORMAT.Decimal(2,&BoxWidth)
	
	OPEN #1 &DialogFileName /Write
	
	WRITE #1 "; '&+' allows you to pass the local macro to a dialog"
	WRITE #1 "; block that is embedded in a *.cmm file"
	WRITE #1 ";"
	WRITE #1 "NAME ""WINDOW_TASK"""
	WRITE #1 "HEADER ""TASK LIST"""
	WRITE #1 ";"
	
	WRITE #1 "; task name"
	&CurrentBoxPosition=FORMAT.Decimal(2,&CurrentSize)
	&CurrentBoxLen=FORMAT.Decimal(2,&TaskNameLen)
	&CurrentSize=&CurrentSize+&TaskNameLen+0x1
	WRITE #1 "POS &CurrentBoxPosition. &DrawLineNum. &CurrentBoxLen. &BoxWidthNum."
	WRITE #1 "BOX ""TASK NAME"""
	
	WRITE #1 "; task prioriry"
	&CurrentBoxPosition=FORMAT.Decimal(2,&CurrentSize)
	&CurrentBoxLen=FORMAT.Decimal(2,&PriorityLen)
	&CurrentSize=&CurrentSize+&PriorityLen+0x1
	WRITE #1 "POS &CurrentBoxPosition. &DrawLineNum. &CurrentBoxLen. &BoxWidthNum."
	WRITE #1 "BOX ""PRI"""
	
	WRITE #1 "; task state"
	&CurrentBoxPosition=FORMAT.Decimal(2,&CurrentSize)
	&CurrentBoxLen=FORMAT.Decimal(2,&TaskStateLen)
	&CurrentSize=&CurrentSize+&TaskStateLen+0x1
	WRITE #1 "POS &CurrentBoxPosition. &DrawLineNum. &CurrentBoxLen. &BoxWidthNum."
	WRITE #1 "BOX ""TASK STATE"""
	
	WRITE #1 "; stack type"
	&CurrentBoxPosition=FORMAT.Decimal(2,&CurrentSize)
	&CurrentBoxLen=FORMAT.Decimal(2,&StackTypeLen)
	&CurrentSize=&CurrentSize+&StackTypeLen+0x1
	WRITE #1 "POS &CurrentBoxPosition. &DrawLineNum. &CurrentBoxLen. &BoxWidthNum."
	WRITE #1 "BOX ""STACK TYPE"""
	
	WRITE #1 "; task tcb"
	&CurrentBoxPosition=FORMAT.Decimal(2,&CurrentSize)
	&CurrentBoxLen=FORMAT.Decimal(2,&TaskCtlBlockLen)
	&CurrentSize=&CurrentSize+&TaskCtlBlockLen+0x1
	WRITE #1 "POS &CurrentBoxPosition. &DrawLineNum. &CurrentBoxLen. &BoxWidthNum."
	WRITE #1 "BOX ""TCB"""
	
	WRITE #1 "; current SP"
	&CurrentBoxPosition=FORMAT.Decimal(2,&CurrentSize)
	&CurrentBoxLen=FORMAT.Decimal(2,&CurrentSPLen)
	&CurrentSize=&CurrentSize+&CurrentSPLen+0x1
	WRITE #1 "POS &CurrentBoxPosition. &DrawLineNum. &CurrentBoxLen. &BoxWidthNum."
	WRITE #1 "BOX ""SP"""
	
	WRITE #1 "; stack top"
	&CurrentBoxPosition=FORMAT.Decimal(2,&CurrentSize)
	&CurrentBoxLen=FORMAT.Decimal(2,&StackTopLen)
	&CurrentSize=&CurrentSize+&StackTopLen+0x1
	WRITE #1 "POS &CurrentBoxPosition. &DrawLineNum. &CurrentBoxLen. &BoxWidthNum."
	WRITE #1 "BOX ""SP TOP"""
	
	WRITE #1 "; stack bottom"
	&CurrentBoxPosition=FORMAT.Decimal(2,&CurrentSize)
	&CurrentBoxLen=FORMAT.Decimal(2,&StackBottomLen)
	&CurrentSize=&CurrentSize+&StackBottomLen+0x1
	WRITE #1 "POS &CurrentBoxPosition. &DrawLineNum. &CurrentBoxLen. &BoxWidthNum."
	WRITE #1 "BOX ""SP BOTTOM"""
	
	WRITE #1 "; stack size"
	&CurrentBoxPosition=FORMAT.Decimal(2,&CurrentSize)
	&CurrentBoxLen=FORMAT.Decimal(2,&StackSizeLen)
	&CurrentSize=&CurrentSize+&StackSizeLen+0x1
	WRITE #1 "POS &CurrentBoxPosition. &DrawLineNum. &CurrentBoxLen. &BoxWidthNum."
	WRITE #1 "BOX ""SIZE"""
	
	WRITE #1 "; stack percent"
	&CurrentBoxPosition=FORMAT.Decimal(2,&CurrentSize)
	&CurrentBoxLen=FORMAT.Decimal(2,&StackPercentLen)
	&CurrentSize=&CurrentSize+&StackPercentLen+0x1
	WRITE #1 "POS &CurrentBoxPosition. &DrawLineNum. &CurrentBoxLen. &BoxWidthNum."
	WRITE #1 "BOX ""%"""
	
	WRITE #1 ";"
	WRITE #1 ";"
	
	CLOSE #1
	
	RETURN
)


dialog_show_task_one_line:
(
	ENTRY &AcceptParameter1 &AcceptParameter2
	
	PRIVATE &CurrentTCB &DrawLineNum
	
	&CurrentTCB=&AcceptParameter1
	&DrawLineNum=FORMAT.Decimal(2,&AcceptParameter2)
	
	PRIVATE &TaskName &Priority &StackType &State &TaskCB &CurrentSP &StackTop &StackBottom &StackSize &StackPercent
	GOSUB get_one_task_attribute &CurrentTCB
	ENTRY &TaskName &Priority &StackType &State &TaskCB &CurrentSP &StackTop &StackBottom &StackSize &StackPercent
	
	PRIVATE &CurrentMemberPosition &CurrentMemberLen &CurrentSize
	
	&CurrentSize=0
	
	OPEN #1 &DialogFileName /Write
	
	&CurrentMemberPosition=FORMAT.Decimal(2,&CurrentSize+&MemberGap)
	&CurrentMemberLen=FORMAT.Decimal(2,&TaskNameLen-2*&MemberGap)
	&CurrentSize=&CurrentSize+&TaskNameLen+1
	WRITE #1 "; task name"
	WRITE #1 "POS &CurrentMemberPosition. &DrawLineNum. &CurrentMemberLen. 1."
	WRITE #1 "BUTTON &TaskName"
	WRITE #1 "(&-"
	WRITE #1 "	PRIVATE &TopOfStack"
	WRITE #1 "	IF &TaskCB==v.value(pxCurrentTCB)"
	WRITE #1 "	("
	WRITE #1 "		;set all of the register of cpu, trace analyze the stack"
	WRITE #1 "		;Register.Init"
	WRITE #1 "		;Register.Reset"
	WRITE #1 "		Register.Set R0        v.value(m3_reg.R0)"
	WRITE #1 "		Register.Set R1        v.value(m3_reg.R1)"
	WRITE #1 "		Register.Set R2        v.value(m3_reg.R2)"
	WRITE #1 "		Register.Set R3        v.value(m3_reg.R3)"
	WRITE #1 "		Register.Set R4        v.value(m3_reg.R4)"
	WRITE #1 "		Register.Set R5        v.value(m3_reg.R5)"
	WRITE #1 "		Register.Set R6        v.value(m3_reg.R6)"
	WRITE #1 "		Register.Set R7        v.value(m3_reg.R7)"
	WRITE #1 "		Register.Set R8        v.value(m3_reg.R8)"
	WRITE #1 "		Register.Set R9        v.value(m3_reg.R9)"
	WRITE #1 "		Register.Set R10       v.value(m3_reg.R10)"
	WRITE #1 "		Register.Set R11       v.value(m3_reg.R11)"
	WRITE #1 "		Register.Set R12       v.value(m3_reg.R12)"
	WRITE #1 "		Register.Set R13       v.value(m3_reg.SP)"
	WRITE #1 "		Register.Set LR        v.value(m3_reg.LR)"
	WRITE #1 "		Register.Set PC        v.value(m3_reg.LR)"
	WRITE #1 "		Register.Set xPSR      v.value(m3_reg.xPSR)"
	WRITE #1 "	)"
	WRITE #1 "	ELSE"
	WRITE #1 "	("
	WRITE #1 "		&TopOfStack=v.value((((TCB_t *)&TaskCB)->pxTopOfStack))"
	WRITE #1 "		; D: it's the type of addrees"
	WRITE #1 "		Register.Set R4    Data.Long(D:(&TopOfStack+0x00))"
	WRITE #1 "		Register.Set R5    Data.Long(D:(&TopOfStack+0x04))"
	WRITE #1 "		Register.Set R6    Data.Long(D:(&TopOfStack+0x08))"
	WRITE #1 "		Register.Set R7    Data.Long(D:(&TopOfStack+0x0C))"
	WRITE #1 "		Register.Set R8    Data.Long(D:(&TopOfStack+0x10))"
	WRITE #1 "		Register.Set R9    Data.Long(D:(&TopOfStack+0x14))"
	WRITE #1 "		Register.Set R10   Data.Long(D:(&TopOfStack+0x18))"
	WRITE #1 "		Register.Set R11   Data.Long(D:(&TopOfStack+0x1C))"
	WRITE #1 "		Register.Set R0    Data.Long(D:(&TopOfStack+0x20))"
	WRITE #1 "		Register.Set R1    Data.Long(D:(&TopOfStack+0x24))"
	WRITE #1 "		Register.Set R2    Data.Long(D:(&TopOfStack+0x28))"
	WRITE #1 "		Register.Set R3    Data.Long(D:(&TopOfStack+0x2C))"
	WRITE #1 "		Register.Set R12   Data.Long(D:(&TopOfStack+0x30))"
	WRITE #1 "		Register.Set LR    Data.Long(D:(&TopOfStack+0x34))"
	WRITE #1 "		Register.Set PC    Data.Long(D:(&TopOfStack+0x38))"
	WRITE #1 "		Register.Set xPSR  Data.Long(D:(&TopOfStack+0x3C))"
	WRITE #1 "		Register.Set SP    (&TopOfStack+0x40)"
	WRITE #1 "	)"
	WRITE #1 "	WinCLEAR StackFrame"
	WRITE #1 "	WinPOS 5% 10% 40% 70% ,,, StackFrame"
	WRITE #1 "	Frame.View /Locals /Caller"
	WRITE #1 ")"
	
	&CurrentMemberPosition=FORMAT.Decimal(2,&CurrentSize+&MemberGap)
	&CurrentMemberLen=FORMAT.Decimal(2,&PriorityLen-2*&MemberGap)
	&CurrentSize=&CurrentSize+&PriorityLen+1
	WRITE #1 "; task prioriry"
	WRITE #1 "POS &CurrentMemberPosition. &DrawLineNum. &CurrentMemberLen. 1."
	WRITE #1 "TEXT FORMAT.Decimal(2,&Priority)"
	
	&CurrentMemberPosition=FORMAT.Decimal(2,&CurrentSize+&MemberGap)
	&CurrentMemberLen=FORMAT.Decimal(2,&TaskStateLen-2*&MemberGap)
	&CurrentSize=&CurrentSize+&TaskStateLen+1
	WRITE #1 "; task state"
	WRITE #1 "POS &CurrentMemberPosition. &DrawLineNum. &CurrentMemberLen. 1"
	WRITE #1 "TEXT &State"
	
	&CurrentMemberPosition=FORMAT.Decimal(2,&CurrentSize+&MemberGap)
	&CurrentMemberLen=FORMAT.Decimal(2,&StackTypeLen-2*&MemberGap)
	&CurrentSize=&CurrentSize+&StackTypeLen+1
	WRITE #1 "; stack type"
	WRITE #1 "POS &CurrentMemberPosition. &DrawLineNum. &CurrentMemberLen. 1."
	WRITE #1 "TEXT &StackType"
	
	&CurrentMemberPosition=FORMAT.Decimal(2,&CurrentSize+&MemberGap)
	&CurrentMemberLen=FORMAT.Decimal(2,&TaskCtlBlockLen-2*&MemberGap)
	&CurrentSize=&CurrentSize+&TaskCtlBlockLen+1
	WRITE #1 "; task tcb"
	WRITE #1 "POS &CurrentMemberPosition. &DrawLineNum. &CurrentMemberLen. 1."
	WRITE #1 "BUTTON ""&TaskCB"""
	WRITE #1 "("
	WRITE #1 "	Var.View %m %s (TCB_t *)&TaskCB"
	WRITE #1 ")"
	
	&CurrentMemberPosition=FORMAT.Decimal(2,&CurrentSize+&MemberGap)
	&CurrentMemberLen=FORMAT.Decimal(2,&CurrentSPLen-2*&MemberGap)
	&CurrentSize=&CurrentSize+&CurrentSPLen+1
	WRITE #1 "; current SP"
	WRITE #1 "POS &CurrentMemberPosition. &DrawLineNum. &CurrentMemberLen. 1."
	WRITE #1 "BUTTON ""&CurrentSP"""
	WRITE #1 "("
	WRITE #1 "	Data.dump &CurrentSP /l /dialog"
	WRITE #1 ")"
	
	&CurrentMemberPosition=FORMAT.Decimal(2,&CurrentSize+&MemberGap)
	&CurrentMemberLen=FORMAT.Decimal(2,&StackTopLen-2*&MemberGap)
	&CurrentSize=&CurrentSize+&StackTopLen+1
	WRITE #1 "; stack top"
	WRITE #1 "POS &CurrentMemberPosition. &DrawLineNum. &CurrentMemberLen. 1."
	WRITE #1 "BUTTON ""&StackTop"""
	WRITE #1 "("
	WRITE #1 "	Data.dump &StackTop /l /dialog"
	WRITE #1 "	;DIALOG.MESSAGE ""Can not click!!!"""
	WRITE #1 ")"
	
	&CurrentMemberPosition=FORMAT.Decimal(2,&CurrentSize+&MemberGap)
	&CurrentMemberLen=FORMAT.Decimal(2,&StackBottomLen-2*&MemberGap)
	&CurrentSize=&CurrentSize+&StackBottomLen+1
	WRITE #1 "; stack bottom"
	WRITE #1 "POS &CurrentMemberPosition. &DrawLineNum. &CurrentMemberLen. 1."
	WRITE #1 "BUTTON ""&StackBottom"""
	WRITE #1 "("
	WRITE #1 "	Data.dump &StackBottom /l /dialog"
	WRITE #1 "	;DIALOG.OK ""Can not click!!!"""
	WRITE #1 ")"
	
	&CurrentMemberPosition=FORMAT.Decimal(2,&CurrentSize+&MemberGap)
	&CurrentMemberLen=FORMAT.Decimal(2,&StackSizeLen-2*&MemberGap)
	&CurrentSize=&CurrentSize+&StackSizeLen+1
	WRITE #1 "; stack size"
	WRITE #1 "POS &CurrentMemberPosition. &DrawLineNum. &CurrentMemberLen. 1."
	WRITE #1 ";TEXT FORMAT.Decimal(2,&StackSize)"
	WRITE #1 "TEXT ""&StackSize"""
	
	&CurrentMemberPosition=FORMAT.Decimal(2,&CurrentSize+&MemberGap)
	&CurrentMemberLen=FORMAT.Decimal(2,&StackPercentLen-2*&MemberGap)
	&CurrentSize=&CurrentSize+&StackPercentLen+1
	WRITE #1 "; stack percent"
	WRITE #1 "POS &CurrentMemberPosition. &DrawLineNum. &CurrentMemberLen. 1."
	WRITE #1 "TEXT &StackPercent"
	
	WRITE #1 ";"
	WRITE #1 ";"
	
	CLOSE #1
	
	RETURN
)


dialog_show_task_others:
(
	ENTRY &AcceptParameter
	
	PRIVATE &DrawLine &DrawLineNum &LineSize &LineSizeNum
	
	&DrawLine=&AcceptParameter
	&LineSize=&TaskNameLen+1+&PriorityLen+1+&TaskStateLen+1+&StackTypeLen+1+&TaskCtlBlockLen+1+&CurrentSPLen+1+&StackTopLen+1+&StackBottomLen+1+&StackSizeLen+1+&StackPercentLen
	&LineSizeNum=FORMAT.Decimal(2,&LineSize)
	
	OPEN #1 &DialogFileName /Write
	
	&DrawLine=&DrawLine+1
	&DrawLineNum=FORMAT.Decimal(2,&DrawLine)
	WRITE #1 "; special button"
	WRITE #1 "POS 0. &DrawLineNum. &LineSizeNum. 1."
	WRITE #1 "BUTTON ""special button: show current task stack in TCB: use in no task ready"""
	WRITE #1 "(&-"
	WRITE #1 "	PRIVATE &TaskCB &TopOfStack"
	WRITE #1 "	&TaskCB=v.value(pxCurrentTCB)"
	WRITE #1 "	&TopOfStack=v.value((((TCB_t *)&TaskCB)->pxTopOfStack))"
	WRITE #1 "	; D: it's the type of addrees"
	WRITE #1 "	Register.Set R4    Data.Long(D:(&TopOfStack+0x00))"
	WRITE #1 "	Register.Set R5    Data.Long(D:(&TopOfStack+0x04))"
	WRITE #1 "	Register.Set R6    Data.Long(D:(&TopOfStack+0x08))"
	WRITE #1 "	Register.Set R7    Data.Long(D:(&TopOfStack+0x0C))"
	WRITE #1 "	Register.Set R8    Data.Long(D:(&TopOfStack+0x10))"
	WRITE #1 "	Register.Set R9    Data.Long(D:(&TopOfStack+0x14))"
	WRITE #1 "	Register.Set R10   Data.Long(D:(&TopOfStack+0x18))"
	WRITE #1 "	Register.Set R11   Data.Long(D:(&TopOfStack+0x1C))"
	WRITE #1 "	Register.Set R0    Data.Long(D:(&TopOfStack+0x20))"
	WRITE #1 "	Register.Set R1    Data.Long(D:(&TopOfStack+0x24))"
	WRITE #1 "	Register.Set R2    Data.Long(D:(&TopOfStack+0x28))"
	WRITE #1 "	Register.Set R3    Data.Long(D:(&TopOfStack+0x2C))"
	WRITE #1 "	Register.Set R12   Data.Long(D:(&TopOfStack+0x30))"
	WRITE #1 "	Register.Set LR    Data.Long(D:(&TopOfStack+0x34))"
	WRITE #1 "	Register.Set PC    Data.Long(D:(&TopOfStack+0x38))"
	WRITE #1 "	Register.Set xPSR  Data.Long(D:(&TopOfStack+0x3C))"
	WRITE #1 "	Register.Set SP    (&TopOfStack+0x40)"
	WRITE #1 "	WinCLEAR StackFrame"
	WRITE #1 "	WinPOS 5% 10% 40% 70% ,,, StackFrame"
	WRITE #1 "	Frame.View /Locals /Caller"
	WRITE #1 ")"
	
	&DrawLine=&DrawLine+1
	&DrawLineNum=FORMAT.Decimal(2,&DrawLine)
	PRIVATE &TmpValue &SystemTick &PendingTick &NextUnblockTick &KernelState &NumberOfTasks &TaskNumber
	&TmpValue=v.value(xTickCount)
	&SystemTick=FORMAT.Decimal(2,&TmpValue)
	&TmpValue=v.value(xPendedTicks)
	&PendingTick=FORMAT.Decimal(2,&TmpValue)
	&TmpValue=v.value(xNextTaskUnblockTime)
	&NextUnblockTick=FORMAT.Decimal(2,&TmpValue)
	&TmpValue=v.value(xSchedulerRunning)
	IF &TmpValue==0
	(
		&KernelState="Not Started"
	)
	ELSE
	(
		&TmpValue=v.value(uxSchedulerSuspended)
		IF &TmpValue==0
		(
			&KernelState="Running"
		)
		ELSE
		(
			&KernelState="SusPended"
		)
	)
	&TmpValue=v.value(uxCurrentNumberOfTasks)
	&NumberOfTasks=FORMAT.Decimal(2,&TmpValue)
	&TmpValue=v.value(uxTaskNumber)
	&TaskNumber=FORMAT.Decimal(2,&TmpValue)
	WRITE #1 "; some OS message"
	WRITE #1 "POS 0. &DrawLineNum. &LineSizeNum. 1."
	WRITE #1 "TEXT ""Kernel Tick:&SystemTick   Pending Ticks:&PendingTick   Next Unblock:&NextUnblockTick   Kernel State:&KernelState   Number of Tasks:&NumberOfTasks   Task Number:&TaskNumber"""
	
	CLOSE #1
	
	RETURN
)


get_task_handler_list:
(
	PRIVATE &pxCurrentList &xTraverse &xNumOfPriority
	PRIVATE &TmpNumOfThread &TmpTaskHandlerList
	PRIVATE &NumOfThread &TaskHandlerList
	
	&NumOfThread=0
	&TaskHandlerList=""

	&xNumOfPriority=v.value(sizeof(pxReadyTasksLists))/v.value(sizeof(pxReadyTasksLists[0]))

	&xTraverse=0

	WHILE &xTraverse<&xNumOfPriority
	(
		&pxCurrentList=v.value(&pxReadyTasksLists[&xTraverse])
		GOSUB get_one_list_task &pxCurrentList
		ENTRY &TmpNumOfThread &TmpTaskHandlerList
		
		&NumOfThread=&NumOfThread+&TmpNumOfThread
		&TaskHandlerList="&TaskHandlerList"+"&TmpTaskHandlerList"
		
		&xTraverse=&xTraverse+1
	)
	
	&pxCurrentList=v.value(&xSuspendedTaskList)
	GOSUB get_one_list_task &pxCurrentList
	ENTRY &TmpNumOfThread &TmpTaskHandlerList
	
	&NumOfThread=&NumOfThread+&TmpNumOfThread
	&TaskHandlerList="&TaskHandlerList"+"&TmpTaskHandlerList"

	&pxCurrentList=v.value(pxDelayedTaskList)
	GOSUB get_one_list_task &pxCurrentList
	ENTRY &TmpNumOfThread &TmpTaskHandlerList
	
	&NumOfThread=&NumOfThread+&TmpNumOfThread
	&TaskHandlerList="&TaskHandlerList"+"&TmpTaskHandlerList"
	
	&pxCurrentList=v.value(pxOverflowDelayedTaskList)
	GOSUB get_one_list_task &pxCurrentList
	ENTRY &TmpNumOfThread &TmpTaskHandlerList
	
	&NumOfThread=&NumOfThread+&TmpNumOfThread
	&TaskHandlerList="&TaskHandlerList"+"&TmpTaskHandlerList"

	&pxCurrentList=v.value(&xPendingReadyList)
	GOSUB get_one_list_task &pxCurrentList
	ENTRY &TmpNumOfThread &TmpTaskHandlerList
	
	&NumOfThread=&NumOfThread+&TmpNumOfThread
	&TaskHandlerList="&TaskHandlerList"+"&TmpTaskHandlerList"

	&pxCurrentList=v.value(&xTasksWaitingTermination)
	GOSUB get_one_list_task &pxCurrentList
	ENTRY &TmpNumOfThread &TmpTaskHandlerList
	
	&NumOfThread=&NumOfThread+&TmpNumOfThread
	&TaskHandlerList="&TaskHandlerList"+"&TmpTaskHandlerList"
	
	RETURN &NumOfThread &TaskHandlerList
)


get_one_list_task:
(
	ENTRY &AcceptParameter
	
	PRIVATE &pxCurrentList &pxCurrentTCB
	
	PRIVATE &NumOfThread &TaskHandlerList
	
	&pxCurrentList=&AcceptParameter
	
	&NumOfThread=v.value(((List_t *)&pxCurrentList)->uxNumberOfItems)
	&TaskHandlerList=""
	
	&pxListEnd=v.value(&(((List_t *)&pxCurrentList)->xListEnd))
	&pxCurrentListItem=&pxListEnd

	WHILE v.value(((ListItem_t *)&pxCurrentListItem)->pxNext)!=&pxListEnd
	(
		&pxCurrentListItem=v.value(((ListItem_t *)&pxCurrentListItem)->pxNext)
		&pxCurrentTCB=v.value(((ListItem_t *)&pxCurrentListItem)->pvOwner)
		
		&TaskHandlerList="&TaskHandlerList"+"&pxCurrentTCB"
	)
	
	RETURN &NumOfThread &TaskHandlerList
)


get_one_task_attribute:
(
	ENTRY &AcceptParameter

	;use to save gosub return value
	PRIVATE &TaskName &Priority &StackType &State &TaskCB &CurrentSP &StackTop &StackBottom &StackSize &StackPercent
	
	&TaskCB=&AcceptParameter
	
	GOSUB get_task_name &TaskCB
	ENTRY &TaskName
	
	GOSUB get_task_priority &TaskCB
	ENTRY &Priority
	
	GOSUB get_task_stack_type &TaskCB
	ENTRY &StackType
	
	GOSUB get_task_state &TaskCB
	ENTRY &State
	
	GOSUB get_task_stack &TaskCB
	ENTRY &CurrentSP &StackTop &StackBottom &StackSize &StackPercent
	
	RETURN &TaskName &Priority &StackType &State &TaskCB &CurrentSP &StackTop &StackBottom &StackSize &StackPercent
)


get_task_name:
(
	ENTRY &AcceptParameter
	
	PRIVATE &pxCurrentTCB
	
	PRIVATE &pcTaskName &pxPrintName
	
	&pxCurrentTCB=&AcceptParameter
	
	&pcTaskName=v.value(((TCB_t *)&pxCurrentTCB)->pcTaskName)
	
	&pxPrintName=Data.STRing(D:&pcTaskName)
	
	RETURN "&pxPrintName"
)


get_task_priority:
(
	ENTRY &AcceptParameter
	
	PRIVATE &pxCurrentTCB
	
	PRIVATE &uxPriority
	
	&pxCurrentTCB=&AcceptParameter
	
	&uxPriority=v.value(((TCB_t *)&pxCurrentTCB)->uxPriority)
	
	RETURN &uxPriority
)


get_task_stack_type:
(
	ENTRY &AcceptParameter
	
	PRIVATE &pxCurrentTCB &StackAttribute
	
	&pxCurrentTCB=&AcceptParameter
	
	IF &IsCustomFreeRTOS
	(
		PRIVATE &xStackType
		
		&xStackType=v.value(((TCB_t *)&pxCurrentTCB)->ucStackType)
		
		IF &xStackType==0
		(
			&StackAttribute="Shared"
		)
		ELSE
		(
			&StackAttribute="Independent"
		)
	)
	ELSE
	(
		&StackAttribute="Independent"
	)
	
	RETURN "&StackAttribute"
)


get_task_state:
(
	ENTRY &AcceptParameter
	
	PRIVATE &pxCurrentTCB
	
	PRIVATE &xStateListItem &pxContainer &uxPriority
	
	PRIVATE &TaskState
	
	&pxCurrentTCB=&AcceptParameter
	
	&xStateListItem=v.value(&(((TCB_t *)&pxCurrentTCB)->xStateListItem))
	
	&pxContainer=v.value(((ListItem_t *)&xStateListItem)->pvContainer)
	
	&uxPriority=v.value(((TCB_t *)&pxCurrentTCB)->uxPriority)
	
	IF &pxContainer==v.value(&pxReadyTasksLists[&uxPriority])
	(
		IF &pxCurrentTCB==v.value(pxCurrentTCB)
		(
			&TaskState="Running"
		)
		ELSE
		(
			&TaskState="Ready"
		)
	)
	ELSE IF &pxContainer==v.value(&xSuspendedTaskList)
	(
		&TaskState="Suspended"
	)
	ELSE IF &pxContainer==v.value(pxDelayedTaskList)
	(
		&TaskState="Delayed"
	)
	ELSE IF &pxContainer==v.value(pxOverflowDelayedTaskList)
	(
		&TaskState="Overflow Delayed"
	)
	ELSE IF &pxContainer==v.value(&xPendingReadyList)
	(
		&TaskState="Pending Ready"
	)
	ELSE IF &pxContainer==v.value(&xTasksWaitingTermination)
	(
		&TaskState="Waiting Termination"
	)
	ELSE
	(
		&TaskState="Error"
	)
	
	RETURN "&TaskState"
)


get_task_stack:
(
	ENTRY &AcceptParameter
	
	PRIVATE &pxCurrentTCB &StackAddr &StackUsed
	
	PRIVATE &CurrentSP &StackTop &StackBottom &StackSize &StackPercent
	
	&pxCurrentTCB=&AcceptParameter
	
	&CurrentSP=v.value(((TCB_t *)&pxCurrentTCB)->pxTopOfStack)
	&StackTop=v.value(((TCB_t *)&pxCurrentTCB)->pxStack)
	&StackBottom=v.value(((TCB_t *)&pxCurrentTCB)->pxEndOfStack)
	&StackSize=&StackBottom-&StackTop
	
	&StackAddr=&StackTop
	WHILE &StackAddr<&CurrentSP
	(
		IF Data.Long(D:(&StackAddr))==0xA5A5A5A5
		(
			&StackAddr=&StackAddr+0x4
			CONTinue
		)
		ELSE
		(
			GOTO exit_while_lable
		)
	)
	
exit_while_lable:
	&StackUsed=&StackBottom-&StackAddr
	
	&StackPercent=&StackUsed*0x64/&StackSize
	
	IF &IsCustomFreeRTOS
	(
		PRIVATE &xStackType
		
		&xStackType=v.value(((TCB_t *)&pxCurrentTCB)->ucStackType)
		
		IF &xStackType!=0
		(
			IF &StackPercent==0x64
			(
				&StackPercent = "over"
			)
			ELSE
			(
				&StackPercent = FORMAT.Decimal(3,&StackPercent)
			)
		)
		ELSE
		(
			&StackPercent = FORMAT.Decimal(3,&StackPercent)
		)
	)
	ELSE
	(
		&StackPercent = FORMAT.Decimal(3,&StackPercent)
	)
	
	RETURN &CurrentSP &StackTop &StackBottom &StackSize "&StackPercent"
)
