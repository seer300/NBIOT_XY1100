; do Display Task
GOSUB display_timer
ENDDO


display_timer:
(
	PRIVATE &NumOfTimer &TimerHandlerList
	GOSUB get_timer_handler_list
	ENTRY &NumOfTimer &TimerHandlerList

	&TimerNameLen=0xC
	&TimerCtlBlockLen=0xC
	&PeriodTicksLen=0xA
	&TimerIDLen=0xC
	&CallbackLen=0xC
	&TimerStatusLen=0xA
	&BoxWidth=&NumOfTimer+2
	&MemberGap=0x1
	&DialogFileName="timer_dialog.dlg"
	
	;PRIVATE &DrawLine &StartLen
	PRIVATE &StartLen &StartLenDec &pxCurrentTimer
	
	&DrawLine=0x0
	&StartLen=0x0
	
	OPEN #1 &DialogFileName /Create
	CLOSE #1
	
	GOSUB dialog_show_timer_title &DrawLine
	
	IF &NumOfTimer!=0
	(
		RePeaT &NumOfTimer
		(
			&StartLenDec=CONVert.HEXTOINT(&StartLen)
			&StartLen=&StartLen+0xA
			&pxCurrentTimer=STRing.MID("&TimerHandlerList",&StartLenDec,10.)
			
			&DrawLine=&DrawLine+0x1
			
			GOSUB dialog_show_timer_one_line &pxCurrentTimer &DrawLine
		)
	)
	
	&DrawLine=&DrawLine+0x1
	GOSUB dialog_show_timer_others &DrawLine
	
	;DIALOG.END
	
	;WinPOS ,,,,,, task_window
	;AREA.Delete task_window
	;AREA.Create task_window ;create a named area that is invisible
	;AREA.Select task_window ;select this area for output
	;DIALOG.AREA task_window &DialogFileName
	DIALOG.View &DialogFileName
	RM &DialogFileName
	
	RETURN
)


dialog_show_timer_title:
(
	ENTRY &AcceptParameter
	
	PRIVATE &DrawLineNum
	&DrawLineNum=FORMAT.Decimal(2,&AcceptParameter)
	
	PRIVATE &CurrentSize &CurrentBoxPosition &CurrentBoxLen &BoxWidthNum
	
	&CurrentSize=0
	&BoxWidthNum=FORMAT.Decimal(2,&BoxWidth)
	
	OPEN #1 &DialogFileName /Write
	
	WRITE #1 "; '&+' allows you to pass the local macro to a dialog"
	WRITE #1 "; block that is embedded in a *.cmm file"
	WRITE #1 ";"
	WRITE #1 "NAME ""WINDOW_TIMER"""
	WRITE #1 "HEADER ""TIMER LIST"""
	WRITE #1 ";"
	
	WRITE #1 "; timer name"
	&CurrentBoxPosition=FORMAT.Decimal(2,&CurrentSize)
	&CurrentBoxLen=FORMAT.Decimal(2,&TimerNameLen)
	&CurrentSize=&CurrentSize+&TimerNameLen+0x1
	WRITE #1 "POS &CurrentBoxPosition. &DrawLineNum. &CurrentBoxLen. &BoxWidthNum."
	WRITE #1 "BOX ""TIMER NAME"""
	
	WRITE #1 "; timer handler"
	&CurrentBoxPosition=FORMAT.Decimal(2,&CurrentSize)
	&CurrentBoxLen=FORMAT.Decimal(2,&TimerCtlBlockLen)
	&CurrentSize=&CurrentSize+&TimerCtlBlockLen+0x1
	WRITE #1 "POS &CurrentBoxPosition. &DrawLineNum. &CurrentBoxLen. &BoxWidthNum."
	WRITE #1 "BOX ""TIMER CB"""
	
	WRITE #1 "; period in ticks"
	&CurrentBoxPosition=FORMAT.Decimal(2,&CurrentSize)
	&CurrentBoxLen=FORMAT.Decimal(2,&PeriodTicksLen)
	&CurrentSize=&CurrentSize+&PeriodTicksLen+0x1
	WRITE #1 "POS &CurrentBoxPosition. &DrawLineNum. &CurrentBoxLen. &BoxWidthNum."
	WRITE #1 "BOX ""PERIOD"""
	
	WRITE #1 "; timer id"
	&CurrentBoxPosition=FORMAT.Decimal(2,&CurrentSize)
	&CurrentBoxLen=FORMAT.Decimal(2,&TimerIDLen)
	&CurrentSize=&CurrentSize+&TimerIDLen+0x1
	WRITE #1 "POS &CurrentBoxPosition. &DrawLineNum. &CurrentBoxLen. &BoxWidthNum."
	WRITE #1 "BOX ""TIMER ID"""
	
	WRITE #1 "; timer callback"
	&CurrentBoxPosition=FORMAT.Decimal(2,&CurrentSize)
	&CurrentBoxLen=FORMAT.Decimal(2,&CallbackLen)
	&CurrentSize=&CurrentSize+&CallbackLen+0x1
	WRITE #1 "POS &CurrentBoxPosition. &DrawLineNum. &CurrentBoxLen. &BoxWidthNum."
	WRITE #1 "BOX ""CALLBACK"""
	
	WRITE #1 "; timer status"
	&CurrentBoxPosition=FORMAT.Decimal(2,&CurrentSize)
	&CurrentBoxLen=FORMAT.Decimal(2,&TimerStatusLen)
	&CurrentSize=&CurrentSize+&TimerStatusLen+0x1
	WRITE #1 "POS &CurrentBoxPosition. &DrawLineNum. &CurrentBoxLen. &BoxWidthNum."
	WRITE #1 "BOX ""STATUS"""
	
	WRITE #1 ";"
	WRITE #1 ";"
	
	CLOSE #1
	
	RETURN
)


dialog_show_timer_one_line:
(
	ENTRY &AcceptParameter1 &AcceptParameter2
	
	PRIVATE &CurrentTimer &DrawLineNum
	
	&CurrentTimer=&AcceptParameter1
	&DrawLineNum=FORMAT.Decimal(2,&AcceptParameter2)
	
	PRIVATE &TimerName &TimerCB &TimerPeriod &TimerID &TimerCallback &TimerStatus
	GOSUB get_one_timer_attribute &CurrentTimer
	ENTRY &TimerName &TimerCB &TimerPeriod &TimerID &TimerCallback &TimerStatus
	
	PRIVATE &CurrentMemberPosition &CurrentMemberLen &CurrentSize
	
	&CurrentSize=0
	
	OPEN #1 &DialogFileName /Write
	
	&CurrentMemberPosition=FORMAT.Decimal(2,&CurrentSize+&MemberGap)
	&CurrentMemberLen=FORMAT.Decimal(2,&TimerNameLen-2*&MemberGap)
	&CurrentSize=&CurrentSize+&TimerNameLen+1
	WRITE #1 "; timer name"
	WRITE #1 "POS &CurrentMemberPosition. &DrawLineNum. &CurrentMemberLen. 1."
	WRITE #1 "TEXT &TimerName"
	
	&CurrentMemberPosition=FORMAT.Decimal(2,&CurrentSize+&MemberGap)
	&CurrentMemberLen=FORMAT.Decimal(2,&TimerCtlBlockLen-2*&MemberGap)
	&CurrentSize=&CurrentSize+&TimerCtlBlockLen+1
	WRITE #1 "; timer handler"
	WRITE #1 "POS &CurrentMemberPosition. &DrawLineNum. &CurrentMemberLen. 1."
	WRITE #1 "BUTTON ""&TimerCB"""
	WRITE #1 "("
	WRITE #1 "	Var.View %m %s (Timer_t *)&TimerCB"
	WRITE #1 ")"
	
	&CurrentMemberPosition=FORMAT.Decimal(2,&CurrentSize+&MemberGap)
	&CurrentMemberLen=FORMAT.Decimal(2,&PeriodTicksLen-2*&MemberGap)
	&CurrentSize=&CurrentSize+&PeriodTicksLen+1
	WRITE #1 "; period in ticks"
	WRITE #1 "POS &CurrentMemberPosition. &DrawLineNum. &CurrentMemberLen. 1."
	WRITE #1 "TEXT FORMAT.Decimal(2,&TimerPeriod)"
	
	&CurrentMemberPosition=FORMAT.Decimal(2,&CurrentSize+&MemberGap)
	&CurrentMemberLen=FORMAT.Decimal(2,&TimerIDLen-2*&MemberGap)
	&CurrentSize=&CurrentSize+&TimerIDLen+1
	WRITE #1 "; timer id"
	WRITE #1 "POS &CurrentMemberPosition. &DrawLineNum. &CurrentMemberLen. 1"
	WRITE #1 "TEXT ""&TimerID"""
	
	&CurrentMemberPosition=FORMAT.Decimal(2,&CurrentSize+&MemberGap)
	&CurrentMemberLen=FORMAT.Decimal(2,&CallbackLen-2*&MemberGap)
	&CurrentSize=&CurrentSize+&CallbackLen+1
	WRITE #1 "; timer callback"
	WRITE #1 "POS &CurrentMemberPosition. &DrawLineNum. &CurrentMemberLen. 1."
	WRITE #1 "BUTTON ""&TimerCallback"""
	WRITE #1 "("
	WRITE #1 "	Break.Set &TimerCallback"
	WRITE #1 "	Break.List"
	WRITE #1 ")"
	
	&CurrentMemberPosition=FORMAT.Decimal(2,&CurrentSize+&MemberGap)
	&CurrentMemberLen=FORMAT.Decimal(2,&TimerStatusLen-2*&MemberGap)
	&CurrentSize=&CurrentSize+&TimerStatusLen+1
	WRITE #1 "; timer status"
	WRITE #1 "POS &CurrentMemberPosition. &DrawLineNum. &CurrentMemberLen. 1."
	WRITE #1 "TEXT ""&TimerStatus"""
	
	WRITE #1 ";"
	WRITE #1 ";"
	
	CLOSE #1
	
	RETURN
)


dialog_show_timer_others:
(
	ENTRY &AcceptParameter
	
	PRIVATE &DrawLine &DrawLineNum &LineSize &LineSizeNum
	
	&DrawLine=&AcceptParameter
	&LineSize=&TimerNameLen+1+&TimerCtlBlockLen+1+&PeriodTicksLen+1+&TimerIDLen+1+&CallbackLen+1+&TimerStatusLen
	&LineSizeNum=FORMAT.Decimal(2,&LineSize)
	
	OPEN #1 &DialogFileName /Write
	
	&DrawLine=&DrawLine+1
	&DrawLineNum=FORMAT.Decimal(2,&DrawLine)
	WRITE #1 "; timer status message"
	WRITE #1 "POS 0. &DrawLineNum. &LineSizeNum. 1."
	WRITE #1 "TEXT ""Timer Status:   bit0: Timer Active   bit1: Timer Statically Allocated   bit2: Timer AutoReload"""
	
	CLOSE #1
	
	RETURN
)


get_timer_handler_list:
(
	PRIVATE &pxCurrentList
	
	PRIVATE &TmpNumOfTimer &TmpTimerHandlerList
	
	PRIVATE &NumOfTimer &TimerHandlerList
	
	&NumOfTimer=0
	&TimerHandlerList=""
	
	&pxCurrentList=v.value(pxCurrentTimerList)
	GOSUB get_one_list_timer &pxCurrentList
	ENTRY &TmpNumOfTimer &TmpTimerHandlerList
	
	&NumOfTimer=&NumOfTimer+&TmpNumOfTimer
	&TimerHandlerList="&TimerHandlerList"+"&TmpTimerHandlerList"

	&pxCurrentList=v.value(pxOverflowTimerList)
	GOSUB get_one_list_timer &pxCurrentList
	ENTRY &TmpNumOfTimer &TmpTimerHandlerList
	
	&NumOfTimer=&NumOfTimer+&TmpNumOfTimer
	&TimerHandlerList="&TimerHandlerList"+"&TmpTimerHandlerList"
	
	RETURN &NumOfTimer &TimerHandlerList
)


get_one_list_timer:
(
	ENTRY &AcceptParameter
	
	PRIVATE &pxCurrentList &pxCurrentTimer
	
	PRIVATE &NumOfTimer &TimerHandlerList
	
	&pxCurrentList=&AcceptParameter
	
	&NumOfTimer=v.value(((List_t *)&pxCurrentList)->uxNumberOfItems)
	&TimerHandlerList=""
	
	&pxListEnd=v.value(&(((List_t *)&pxCurrentList)->xListEnd))
	&pxCurrentListItem=&pxListEnd

	WHILE v.value(((ListItem_t *)&pxCurrentListItem)->pxNext)!=&pxListEnd
	(
		&pxCurrentListItem=v.value(((ListItem_t *)&pxCurrentListItem)->pxNext)
		&pxCurrentTimer=v.value(((ListItem_t *)&pxCurrentListItem)->pvOwner)
		
		&TimerHandlerList="&TimerHandlerList"+"&pxCurrentTimer"
	)
	
	RETURN &NumOfTimer &TimerHandlerList
)


get_one_timer_attribute:
(
	ENTRY &AcceptParameter
	
	PRIVATE &TimerName &CurrentTimerCB &TimerPeriod &TimerID &TimerCallback &TimerStatus
	
	&CurrentTimerCB=&AcceptParameter
	
	GOSUB get_timer_name &CurrentTimerCB
	ENTRY &TimerName
	
	GOSUB get_timer_period &CurrentTimerCB
	ENTRY &TimerPeriod
	
	GOSUB get_timer_ID &CurrentTimerCB
	ENTRY &TimerID
	
	GOSUB get_timer_callback &CurrentTimerCB
	ENTRY &TimerCallback
	
	GOSUB get_timer_status &CurrentTimerCB
	ENTRY &TimerStatus
	
	RETURN &TimerName &CurrentTimerCB &TimerPeriod &TimerID &TimerCallback &TimerStatus
)


get_timer_name:
(
	ENTRY &AcceptParameter
	
	PRIVATE &CurrentTimer &TimerName &PrintName
	
	&CurrentTimer=&AcceptParameter
	
	&TimerName=v.value(((Timer_t *)&CurrentTimer)->pcTimerName)
	
	&PrintName=Data.STRing(D:&TimerName)
	
	RETURN "&PrintName"
)


get_timer_period:
(
	ENTRY &AcceptParameter
	
	PRIVATE &CurrentTimer &TimerPeriod
	
	&CurrentTimer=&AcceptParameter
	
	&TimerPeriod=v.value(((Timer_t *)&CurrentTimer)->xTimerPeriodInTicks)
	
	RETURN &TimerPeriod
)


get_timer_ID:
(
	ENTRY &AcceptParameter
	
	PRIVATE &CurrentTimer &TimerID
	
	&CurrentTimer=&AcceptParameter
	
	&TimerID=v.value(((Timer_t *)&CurrentTimer)->pvTimerID)
	
	RETURN &TimerID
)


get_timer_callback:
(
	ENTRY &AcceptParameter
	
	PRIVATE &CurrentTimer &TimerCallback
	
	&CurrentTimer=&AcceptParameter
	
	&TimerCallback=v.value(((Timer_t *)&CurrentTimer)->pxCallbackFunction)
	
	RETURN &TimerCallback
)


get_timer_status:
(
	ENTRY &AcceptParameter
	
	PRIVATE &CurrentTimer &TimerStatus
	
	&CurrentTimer=&AcceptParameter
	
	&TimerStatus=v.value(((Timer_t *)&CurrentTimer)->ucStatus)
	
	RETURN &TimerStatus
)