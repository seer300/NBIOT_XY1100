; --------------------------------------------------------------------------------
; @Title: FreeRTOS Demo for TRACE32 OS Awareness
; @Description:
;
;   This batchfile loads all necessary files to demonstrate
;   the OS Awareness for FreeRTOS on CortexM3.
;
; @Keywords: Awareness, FreeRTOS, RTOS
; @Author: LinJiajun
; @Copyright: (C)
; --------------------------------------------------------------------------------


SCREEN.ON
AREA.RESet
;WinPAGE.RESet
;WinCLEAR
;WinPOS 0. 27. 63. 7. 0. 0. W006
;AREA.view

; Debugger reset
PRINT "Resetting..."
RESet
SYStem.RESet

; Initializing Debugger
PRINT "Set kernel architecture..."
SYStem.CPU CortexM3
SYStem.Up

; load elf and binary files
PRINT "Load elf and bin files..."
Data.LOAD.Elf    ..\..\valid_file\xinyiNBSoC.elf
DATA.LOAD.BINARY ..\..\valid_file\sram.bin   0x20000000  /noclear


;choose os type, is custom freertos or normal freertos
GLOBAL &IsCustomFreeRTOS
;&IsCustomFreeRTOS=TRUE()
&IsCustomFreeRTOS=FALSE()


; initialize RTOS support
PRINT "Initializing FreeRTOS support..."
;TASK.CONFIG FreeRTOS           ; load FreeRTOS awareness (freertos.t32)
MENU.ReProgram ./FreeRTOS.men   ; load FreeRTOS menu (freertos.men)
;HELP.FILTER.Add rtosfreertos   ; add FreeRTOS awareness manual to filtered help
; analyze current stack
;DO ./FreeRTOS_MainStack.cmm
DODECRYPT "LinJiajun"  ./FreeRTOS_MainStack.t32

; temporary script
;DO ./FreeRTOS_Heap_Test.cmm 0x2000C000
;DODECRYPT "LinJiajun" ./FreeRTOS_Heap_Test.t32 0x2000C000

PRINT "Main script end"