; do Display Heap
GOSUB display_heap
ENDDO

display_heap:
(
	WINPOS 30% 10% 55% 60%
	
	AREA.Delete heap_used_window
	AREA.Create heap_used_window 2000. 2000.
	;AREA.Select heap_used_window
	AREA.View heap_used_window
	
	GOSUB display_heap_msg
	GOSUB display_used_heap_list
	GOSUB display_free_heap_list
	
	RETURN
)


display_heap_msg:
(
	PRIVATE &pxEnd &xBlockAllocatedBit &xFreeBytesRemaining &pxStart &pxHeapUsed
	PRIVATE &xMinimumEverFreeBytesRemaining &xNumberOfSuccessfulAllocations &xNumberOfSuccessfulFrees
	
	&pxStart=v.value(&xStart)
	&pxEnd=v.value(pxEnd)
	&pxHeapUsed=v.value(&xHeapUsed)
	&xBlockAllocatedBit=v.value(xBlockAllocatedBit)
	&xFreeBytesRemaining=v.value(xFreeBytesRemaining)
	&xMinimumEverFreeBytesRemaining=v.value(xMinimumEverFreeBytesRemaining)
	&xNumberOfSuccessfulAllocations=v.value(xNumberOfSuccessfulAllocations)
	&xNumberOfSuccessfulFrees=v.value(xNumberOfSuccessfulFrees)
	
	PRINT " "
	PRINT "Heap Message:"
	
	PRINT "  &xStart                        : &pxStart"
	PRINT "  pxEnd                          : &pxEnd"
	PRINT "  &xHeapUsed                     : &pxHeapUsed"
	PRINT "  xBlockAllocatedBit             : &xBlockAllocatedBit"
	PRINT "  xFreeBytesRemaining            : &xFreeBytesRemaining, "+FORMAT.Decimal(7,&xFreeBytesRemaining)
	PRINT "  xMinimumEverFreeBytesRemaining : &xMinimumEverFreeBytesRemaining, "+FORMAT.Decimal(7,&xMinimumEverFreeBytesRemaining)
	PRINT "  xNumberOfSuccessfulAllocations : &xNumberOfSuccessfulAllocations, "+FORMAT.Decimal(7,&xNumberOfSuccessfulAllocations)
	PRINT "  xNumberOfSuccessfulFrees       : &xNumberOfSuccessfulFrees, "+FORMAT.Decimal(7,&xNumberOfSuccessfulFrees)
	
	RETURN
)


display_used_heap_list:
(
	PRIVATE &HeapUsed &NextBlock
	
	&HeapUsed=v.value(&xHeapUsed)
	&NextBlock=v.value(((BlockLink_t *)&HeapUsed)->pxNextBlock)
	
	PRIVATE &ActualBlockSize &AlignWastedSize &UsedFlag &File &Line
	
	PRIVATE &Sequence
	&Sequence=0
	
	PRINT " "
	PRINT "Heap Used List:"
	
	WHILE &NextBlock!=0
	(
		GOSUB get_one_Block_msg &NextBlock
		ENTRY &ActualBlockSize &AlignWastedSize &UsedFlag &File &Line
		
		&Sequence=&Sequence+1
		
		PRINT FORMAT.Decimal(4,&Sequence)+"  BlockAddr: &NextBlock"+"  ActualBlockSize: "+FORMAT.Decimal(7,&ActualBlockSize)+"  AlignWastedSize: "+FORMAT.Decimal(3,&AlignWastedSize)+FORMAT.STRing("  FileName: "+&File,18,' ')+"  LineNum: "+FORMAT.Decimal(5,&Line)
		
		&NextBlock=v.value(((BlockLink_t *)&NextBlock)->pxNextBlock)
		
		IF &Sequence>=0x5DC
		(
			GOTO exit_heap_used_list_loop
		)
	)
	
exit_heap_used_list_loop:
	
	RETURN
)

display_free_heap_list:
(
	PRIVATE &HeapFree &NextBlock
	
	&HeapFree=v.value(&xStart)
	&NextBlock=v.value(((BlockLink_t *)&HeapFree)->pxNextBlock)
	
	PRIVATE &ActualBlockSize &AlignWastedSize &UsedFlag &File &Line
	
	PRIVATE &Sequence
	&Sequence=0
	
	PRINT " "
	PRINT "Heap Free List:"
	
	WHILE &NextBlock!=v.value(pxEnd)
	(
		GOSUB get_one_Block_msg &NextBlock
		ENTRY &ActualBlockSize &AlignWastedSize &UsedFlag &File &Line
		
		&Sequence=&Sequence+1
		
		PRINT FORMAT.Decimal(4,&Sequence)+"  BlockAddr: &NextBlock"+"  ActualBlockSize: "+FORMAT.Decimal(7,&ActualBlockSize)+"  AlignWastedSize: "+FORMAT.Decimal(3,&AlignWastedSize)+FORMAT.STRing("  FileName: "+&File,18,' ')+"  LineNum: "+FORMAT.Decimal(5,&Line)
		
		&NextBlock=v.value(((BlockLink_t *)&NextBlock)->pxNextBlock)
		
		IF &Sequence>=0x190
		(
			GOTO exit_heap_free_list_loop
		)
	)

exit_heap_free_list_loop:
	
	RETURN
)

get_one_Block_msg:
(
	ENTRY &AcceptParameter
	
	PRIVATE &CurrentBlock
	&CurrentBlock=&AcceptParameter
	
	PRIVATE &ActualBlockSize &AlignWastedSize &UsedFlag &File &Line
	PRIVATE &FileAddress
	
	&ActualBlockSize=V.VALUE(((BlockLink_t *)&CurrentBlock)->xActualBlockSize)
	&AlignWastedSize=V.VALUE(((BlockLink_t *)&CurrentBlock)->xAlignWastedSize)
	&UsedFlag=V.VALUE(((BlockLink_t *)&CurrentBlock)->xUsedFlag)
	&FileAddress=V.VALUE(((BlockLink_t *)&CurrentBlock)->pcFile)
	&File=Data.STRing(D:&FileAddress)
	&Line=V.VALUE(((BlockLink_t *)&CurrentBlock)->xLine)
	
	RETURN &ActualBlockSize &AlignWastedSize &UsedFlag "&File" &Line
)